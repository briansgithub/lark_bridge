## firmware/s31/main/Kconfig.projbuild
```kconfig
menu "LarkBridge S31 gateway"

config LARKBRIDGE_S31_ERASE_BONDS_ON_BOOT
    bool "Erase S31 settings and Bluetooth bonds on every boot"
    default n
    help
        Recovery-image option. Enable, flash and boot once to forget the bound
        Pixel, then disable and flash the normal image. Do not leave enabled.

config LARKBRIDGE_S31_ROUTE_DRAIN_GUARD_MS
    int "Silence guard before opening a new audio route (ms)"
    range 100 2000
    default 350
    help
        After the output board acknowledges and flushes a SILENCE route, keep
        both endpoints silent for this additional pipeline-drain interval.
        The default is deliberately conservative and must be tuned with the
        arrival-day stale-media boundary test.

config LARKBRIDGE_S31_AEC_ENGINE
    bool "Create the ESP-SR AEC engine during calls"
    default n
    help
        Off by default in base images until H10 qualification is frozen.
        With the engine off, the call uplink stays digital silence.
        When enabled with PSRAM (sdkconfig.aec-fd), runs ESP-SR VOIP_LOW_COST
        on Core 1 with PSRAM-backed mic/reference rings and BT PSRAM-first
        allocation.

config LARKBRIDGE_S31_AEC_LINEAR_ONLY
    bool "Use the linear-only ESP-SR AEC mode for D5"
    depends on LARKBRIDGE_S31_AEC_ENGINE
    default n
    help
        Use SR_LOW_COST to bypass the nonlinear initializer. This bench
        comparison does not require enabling PSRAM and does not qualify
        the resulting echo suppression for call uplink use.

config LARKBRIDGE_S31_EXPERIMENTAL_AEC_UPLINK
    bool "Enable unqualified ESP-SR AEC call uplink"
    depends on LARKBRIDGE_S31_AEC_ENGINE
    default n
    help
        Keep disabled in normal images. Enabling permits processed LARK audio
        to reach the Pixel only after the route fence is open and fresh mic
        plus downlink-reference frames have passed ESP-SR AEC. This remains
        an arrival-day bench option until the documented echo-suppression,
        clipping, latency, and stability gates pass on the assembled device.

config LARKBRIDGE_S31_AEC_REFERENCE_DELAY_MS
    int "Initial acoustic-reference delay compensation (ms)"
    range 0 880
    default 160
    help
        Initial delay applied to the HFP downlink reference in the PSRAM
        reference delay line before AEC processing, compensating for I2S,
        downstream A2DP, car head-unit, and acoustic latency (up to 880 ms).
        The runtime cross-correlation tracker automatically adjusts this delay
        when the downstream sink's acoustic path differs or drifts mid-call.

config LARKBRIDGE_TEST_IMAGE
    bool "Build a qualification test image (tone/tap/fault hooks)"
    default n
    help
        Compiles the stage-isolation tone generators, tap digests and fault
        hooks into the image and marks it image=test in every telemetry record
        and in the build manifest. Release images reject those commands.
        Built with: build_firmware.py <target> --image test

config LARKBRIDGE_STATS_PERIOD_MS
    int "JSON stats record period (ms)"
    range 200 60000
    default 1000

endmenu
```
